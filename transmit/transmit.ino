static int codeon[]={380,2320,384,1160,388,1160,388,1160,1164,388,1168,380,1164,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1036,516};
static int codeoff[]={388,2308,388,1160,388,1160,388,1164,1164,388,388,1160,1156,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1032,528};
int ledState = LOW;
unsigned long previousMicros = 0;
int interval;
int loopindex=0;
void setup() {
  pinMode(2, OUTPUT);
  digitalWrite(2, ledState);
  Serial.begin(9600);
  Serial.println('hello');
}

void switch_off() {
  digitalWrite(2, LOW);
  delay(15);
  while ( true ){
  unsigned long currentMicros = micros();
  interval=codeoff[loopindex];
  if (currentMicros - previousMicros >= interval) {
    previousMicros = currentMicros;
    if (ledState == LOW) {
      ledState = HIGH;
    } else {
      ledState = LOW;
    }
    digitalWrite(2, ledState);
    loopindex++;
    if (loopindex == 399 ){
      loopindex=0;
      break;}}}}

void switch_on() {
  digitalWrite(2, LOW);
  delay(15);
  while ( true ){
  unsigned long currentMicros = micros();
  interval=codeon[loopindex];
  if (currentMicros - previousMicros >= interval) {
    previousMicros = currentMicros;
    if (ledState == LOW) {
      ledState = HIGH;
    } else {
      ledState = LOW;
    }
    digitalWrite(2, ledState);
    loopindex++;
    if (loopindex == 399 ){
      loopindex=0;
      break;}}}}

void loop(){
	if (Serial.available() > 0) {
		char in = (char)Serial.read();
                if (in == '1'){
		switch_on();}
		else if (in == '0'){
		switch_off();}}}
